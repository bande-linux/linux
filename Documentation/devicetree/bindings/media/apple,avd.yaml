## Documentation/devicetree/bindings/media/apple,avd.yaml
```yaml
# SPDX-License-Identifier: (GPL-2.0-only OR BSD-2-Clause)
%YAML 1.2
---
$id: http://devicetree.org/schemas/media/apple,avd.yaml#
$schema: http://devicetree.org/meta-schemas/core.yaml#

title: Apple Video Decoder (AVD)

maintainers:
  - Sven Peter <sven@kernel.org>
  - Janne Grunau <j@jannau.net>

description:
  AVD is the stateless video decoder of Apple Silicon SoCs. A Cortex-M3
  coprocessor runs firmware loaded by the operating system and forwards
  the decoder pipeline interrupts through a mailbox.

properties:
  compatible:
    oneOf:
      - items:
          - enum:
              - apple,t6030-avd
              - apple,t6031-avd
          - const: apple,t8122-avd
      - enum:
          - apple,t6000-avd
          - apple,t6020-avd
          - apple,t8103-avd
          - apple,t8112-avd
          - apple,t8122-avd

  reg:
    items:
      - description: coprocessor code memory
      - description: coprocessor SRAM
      - description: coprocessor mailbox registers
      - description: decoder control registers

  reg-names:
    items:
      - const: code
      - const: sram
      - const: mbox
      - const: ctrl

  interrupts:
    minItems: 2
    items:
      - description: mailbox 0
      - description: mailbox 1
      - description: mailbox 2
      - description: mailbox 3
      - description: flag 0
      - description: flag 1

  iommus:
    maxItems: 1

  power-domains:
    maxItems: 1

  resets:
    maxItems: 1

required:
  - compatible
  - reg
  - reg-names
  - interrupts
  - iommus
  - power-domains
  - resets

additionalProperties: false

examples:
  - |
    #include <dt-bindings/interrupt-controller/apple-aic.h>
    #include <dt-bindings/interrupt-controller/irq.h>

    soc {
        #address-cells = <2>;
        #size-cells = <2>;

        video-codec@269080000 {
            compatible = "apple,t8112-avd";
            reg = <0x2 0x69080000 0x0 0x10000>,
                  <0x2 0x69090000 0x0 0x10000>,
                  <0x2 0x690a0000 0x0 0x4000>,
                  <0x2 0x69100000 0x0 0x10000>;
            reg-names = "code", "sram", "mbox", "ctrl";
            interrupt-parent = <&aic>;
            interrupts = <AIC_IRQ 667 IRQ_TYPE_LEVEL_HIGH>,
                         <AIC_IRQ 668 IRQ_TYPE_LEVEL_HIGH>;
            iommus = <&avd_dart 0>;
            power-domains = <&ps_avd_sys>;
            resets = <&ps_avd_sys>;
        };
    };
```

## Documentation/devicetree/bindings/sound/apple,macaudio.yaml
```yaml
# SPDX-License-Identifier: (GPL-2.0-only OR BSD-2-Clause)
%YAML 1.2
---
$id: http://devicetree.org/schemas/sound/apple,macaudio.yaml#
$schema: http://devicetree.org/meta-schemas/core.yaml#

title: Apple Silicon Macs integrated sound peripherals

description:
  This binding represents the overall machine-level integration of sound
  peripherals on 'Apple Silicon' machines by Apple.

maintainers:
  - Martin Povišer <povik+lin@cutebit.org>

properties:
  compatible:
    oneOf:
      - items:
          - enum:
              - apple,j180-macaudio
              - apple,j274-macaudio
              - apple,j293-macaudio
              - apple,j313-macaudio
              - apple,j314-macaudio
              - apple,j316-macaudio
              - apple,j375-macaudio
              - apple,j413-macaudio
              - apple,j415-macaudio
              - apple,j433-macaudio
              - apple,j434-macaudio
              - apple,j456-macaudio
              - apple,j457-macaudio
              - apple,j473-macaudio
              - apple,j493-macaudio
          - const: apple,macaudio
      - items:
          - enum:
              - apple,j414-macaudio
              - apple,j504-macaudio
              - apple,j514-macaudio
          - const: apple,j314-macaudio
          - const: apple,macaudio
      - items:
          - enum:
              - apple,j416-macaudio
              - apple,j516-macaudio
          - const: apple,j316-macaudio
          - const: apple,macaudio
      - items:
          - enum:
              - apple,j475-macaudio
              - apple,j575-macaudio
          - const: apple,j375-macaudio
          - const: apple,macaudio
      - items:
          - const: apple,j613-macaudio
          - const: apple,j413-macaudio
          - const: apple,macaudio
      - items:
          - const: apple,j615-macaudio
          - const: apple,j415-macaudio
          - const: apple,macaudio
      - items:
          - const: apple,j474-macaudio
          - const: apple,j473-macaudio
          - const: apple,macaudio

  "#address-cells":
    const: 1

  "#size-cells":
    const: 0

  model:
    description:
      Model name for presentation to users
    $ref: /schemas/types.yaml#/definitions/string

patternProperties:
  "^dai-link@[0-9a-f]+$":
    description: |
      Node for each sound peripheral such as the speaker array, headphones jack,
      or microphone.
    type: object

    additionalProperties: false

    patternProperties:
      "^dai-tdm-idle-mode-[0-7]$":
        description: |
          How CODEC N of this link drives the TX slots in its
          dai-tdm-slot-tx-idle-mask-N, slots of the shared data line in which
          it does not transmit, so that they do not float. CODECs are numbered
          across the link in codec sound-dai order.
            zero: drive the slots low.
            pulldown: weakly pull the slots low.
        $ref: /schemas/types.yaml#/definitions/string
        enum:
          - zero
          - pulldown

      "^dai-tdm-slot-tx-idle-mask-[0-7]$":
        description:
          Bit mask of the TX slots on the data line that CODEC N drives as
          dai-tdm-idle-mode-N says, bit 0 being slot 0.
        $ref: /schemas/types.yaml#/definitions/uint32

    dependentRequired:
      dai-tdm-slot-tx-idle-mask-0: [ dai-tdm-idle-mode-0 ]
      dai-tdm-slot-tx-idle-mask-1: [ dai-tdm-idle-mode-1 ]
      dai-tdm-slot-tx-idle-mask-2: [ dai-tdm-idle-mode-2 ]
      dai-tdm-slot-tx-idle-mask-3: [ dai-tdm-idle-mode-3 ]
      dai-tdm-slot-tx-idle-mask-4: [ dai-tdm-idle-mode-4 ]
      dai-tdm-slot-tx-idle-mask-5: [ dai-tdm-idle-mode-5 ]
      dai-tdm-slot-tx-idle-mask-6: [ dai-tdm-idle-mode-6 ]
      dai-tdm-slot-tx-idle-mask-7: [ dai-tdm-idle-mode-7 ]

    properties:
      reg:
        maxItems: 1

      link-name:
        description: |
          Name for the peripheral, expecting 'Speaker' or 'Speakers' if this is
          the speaker array.
        $ref: /schemas/types.yaml#/definitions/string

      cpu:
        type: object

        properties:
          sound-dai:
            description: |
              DAI list with CPU-side I2S ports involved in this peripheral.
            minItems: 1
            maxItems: 2

        required:
          - sound-dai

      codec:
        type: object

        properties:
          sound-dai:
            minItems: 1
            maxItems: 8
            description: |
              DAI list with the CODEC-side DAIs connected to the above CPU-side
              DAIs and involved in this sound peripheral.

              The list is in left/right order if applicable. If there are more
              than one CPU-side DAIs (there can be two), the CODECs must be
              listed first those connected to the first CPU, then those
              connected to the second.

              In addition, on some machines with many speaker codecs, the CODECs
              are listed in this fixed order:

              J293: Left Front, Left Rear, Right Front, Right Rear
              J314: Left Woofer 1, Left Tweeter, Left Woofer 2,
                    Right Woofer 1, Right Tweeter, Right Woofer 2

        required:
          - sound-dai

    required:
      - reg
      - cpu
      - codec

required:
  - compatible
  - model
  - "#address-cells"
  - "#size-cells"

additionalProperties: false

examples:
  - |
    mca: mca@9b600000 {
      compatible = "apple,t6000-mca", "apple,mca";
      reg = <0x9b600000 0x10000>,
            <0x9b500000 0x20000>;

      clocks = <&nco 0>, <&nco 1>, <&nco 2>, <&nco 3>;
      power-domains = <&ps_audio_p>, <&ps_mca0>, <&ps_mca1>,
                      <&ps_mca2>, <&ps_mca3>;
      dmas = <&admac 0>, <&admac 1>, <&admac 2>, <&admac 3>,
             <&admac 4>, <&admac 5>, <&admac 6>, <&admac 7>,
             <&admac 8>, <&admac 9>, <&admac 10>, <&admac 11>,
             <&admac 12>, <&admac 13>, <&admac 14>, <&admac 15>;
      dma-names = "tx0a", "rx0a", "tx0b", "rx0b",
                  "tx1a", "rx1a", "tx1b", "rx1b",
                  "tx2a", "rx2a", "tx2b", "rx2b",
                  "tx3a", "rx3a", "tx3b", "rx3b";

      #sound-dai-cells = <1>;
    };

    sound {
      compatible = "apple,j314-macaudio", "apple,macaudio";
      model = "MacBook Pro J314 integrated audio";

      #address-cells = <1>;
      #size-cells = <0>;

      dai-link@0 {
        reg = <0>;
        link-name = "Speakers";

        cpu {
          sound-dai = <&mca 0>, <&mca 1>;
        };
        codec {
          sound-dai = <&speaker_left_woof1>,
                      <&speaker_left_tweet>,
                      <&speaker_left_woof2>,
                      <&speaker_right_woof1>,
                      <&speaker_right_tweet>,
                      <&speaker_right_woof2>;
        };
      };

      dai-link@1 {
        reg = <1>;
        link-name = "Headphones Jack";

        cpu {
          sound-dai = <&mca 2>;
        };
        codec {
          sound-dai = <&jack_codec>;
        };
      };
    };
```

## drivers/media/platform/apple/avd/Kconfig
```kconfig
# SPDX-License-Identifier: GPL-2.0-only

config VIDEO_APPLE_AVD
	tristate "Apple Video Decoder driver"
	depends on ARCH_APPLE || COMPILE_TEST
	depends on PM
	depends on VIDEO_DEV
	depends on V4L_MEM2MEM_DRIVERS
	select MEDIA_CONTROLLER
	select V4L2_MEM2MEM_DEV
	select VIDEOBUF2_DMA_CONTIG
	select V4L2_H264
	help
	  Support for the Apple Video Decoder (AVD) of the Apple M2, a
	  stateless video decoder. It needs the avd-fw coprocessor
	  firmware.

	  To compile this driver as a module, choose M here: the module
	  will be called apple-avd.
```
